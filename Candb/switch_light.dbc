VERSION ""

NS_ :

BS_:

BU_:

BO_ 256 SwitchState: 1 Vector__XXX
 SG_ sSwitch : 0|1@1+ (1,0) [0|1] "" Vector__XXX

BA_DEF_  "BusType" STRING ;
BA_DEF_DEF_  "BusType" "CAN";
